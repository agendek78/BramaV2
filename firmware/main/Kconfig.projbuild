## firmware/main/Kconfig.projbuild
```kconfig
menu "Brama"

    config BRAMA_GPIO_OPEN
        int "GPIO wyjścia OPEN"
        range 0 39
        default 21

    config BRAMA_GPIO_CLOSE
        int "GPIO wyjścia CLOSE"
        range 0 39
        default 22

    config BRAMA_GPIO_PAIR_BUTTON
        int "GPIO przycisku PAIR_BUTTON"
        range 0 39
        default 27

    config BRAMA_GPIO_STATUS_LED
        int "GPIO diody STATUS_LED"
        range 0 39
        default 23

    config BRAMA_GPIO_INTERLOCK
        int "GPIO wejścia INTERLOCK"
        range 0 39
        default 33

    config BRAMA_OUTPUT_ACTIVE_HIGH
        bool "Wyjścia aktywne stanem wysokim"
        default y
        help
            Spec 2.2: wyjścia aktywne wysokim są założeniem projektu. Moduł aktywny stanem niskim
            wymaga wyłączenia tej opcji i sprawdzenia zachowania przy starcie.

    config BRAMA_LED_ACTIVE_LOW
        bool "Dioda STATUS_LED świeci stanem niskim"
        default n
        help
            Włącz, gdy dioda jest podłączona anodą do zasilania (świeci przy poziomie 0 na GPIO).

endmenu
```
